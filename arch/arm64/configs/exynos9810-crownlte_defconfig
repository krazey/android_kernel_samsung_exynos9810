## drivers/crypto/fmp/Kconfig
```kconfig
#
# SMU/FMP controller drivers
#
config EXYNOS_FMP
	tristate "Samsung EXYNOS FMP driver"
	depends on SCSI_UFS_CRYPTO
	help
	  Say yes here to build support for FMP (Flash Memory Protector)
	  to encrypt and decrypt userdata using inline H/W crypto module.
	  If unsure, say N.

	  To compile this driver as a module, choose M here
```

## fs/crypto/Kconfig
```kconfig
config FS_ENCRYPTION
	tristate "FS Encryption (Per-file encryption)"
	select CRYPTO
	select CRYPTO_AES
	select CRYPTO_CBC
	select CRYPTO_ECB
	select CRYPTO_XTS
	select CRYPTO_CTS
	select CRYPTO_SHA512
	select CRYPTO_HMAC
	select KEYS
	help
	  Enable encryption of files and directories.  This
	  feature is similar to ecryptfs, but it is more memory
	  efficient since it avoids caching the encrypted and
	  decrypted pages in the page cache.

config FS_ENCRYPTION_INLINE_CRYPT
	bool "Enable fscrypt to use inline crypto"
	depends on FS_ENCRYPTION && BLK_INLINE_ENCRYPTION
	help
	  Enable fscrypt to use inline encryption hardware if available.
```
